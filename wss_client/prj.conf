## CMakeLists.txt
```
#
# Copyright (c) 2020 Nordic Semiconductor
#
# SPDX-License-Identifier: LicenseRef-Nordic-5-Clause
#

cmake_minimum_required(VERSION 3.20.0)

find_package(Zephyr REQUIRED HINTS $ENV{ZEPHYR_BASE})
project(wss_client)

# NORDIC SDK APP START
target_sources(app PRIVATE src/main.c)
# NORDIC SDK APP END
```

## prj.conf
```kconfig
#
# Copyright (c) 2023 Nordic Semiconductor ASA
#
# SPDX-License-Identifier: LicenseRef-Nordic-5-Clause
#

# General
CONFIG_HEAP_MEM_POOL_SIZE=1024
CONFIG_MAIN_STACK_SIZE=4096

# Logging
CONFIG_LOG=y

# Network
CONFIG_NETWORKING=y
CONFIG_NET_SOCKETS=y
CONFIG_POSIX_API=y
CONFIG_NET_IPV4=y
CONFIG_NET_IPV6=n

CONFIG_LTE_LINK_CONTROL=y
CONFIG_LTE_NETWORK_MODE_NBIOT=y
CONFIG_LTE_LINK_CONTROL_LOG_LEVEL_DBG=y

CONFIG_WEBSOCKET_CLIENT=y


# Logging
CONFIG_LOG_MODE_IMMEDIATE=y
CONFIG_NET_LOG=y
CONFIG_NET_SOCKETS_LOG_LEVEL_DBG=y
CONFIG_NET_HTTP_LOG_LEVEL_DBG=y
CONFIG_NET_WEBSOCKET_LOG_LEVEL_DBG=y
CONFIG_NET_CONTEXT_LOG_LEVEL_DBG=y
CONFIG_NET_TCP_LOG_LEVEL_DBG=y

# TFM configuration
CONFIG_TFM_PROFILE_TYPE_NOT_SET=y

# MbedTLS and security
CONFIG_MBEDTLS=y
CONFIG_NET_SOCKETS_SOCKOPT_TLS=y
CONFIG_MBEDTLS_ENABLE_HEAP=y
CONFIG_MBEDTLS_SSL_IN_CONTENT_LEN=4096
CONFIG_MBEDTLS_SSL_OUT_CONTENT_LEN=4096
CONFIG_MBEDTLS_HEAP_SIZE=32768
CONFIG_MBEDTLS_RSA_C=y
CONFIG_MBEDTLS_TLS_LIBRARY=y
CONFIG_MBEDTLS_X509_LIBRARY=y
CONFIG_MBEDTLS_PKCS1_V15=y
CONFIG_NRF_SECURITY_ADVANCED=y
CONFIG_NORDIC_SECURITY_BACKEND=y
CONFIG_PSA_CRYPTO_DRIVER_CC3XX=y
CONFIG_PSA_WANT_ALG_SHA_1=y
CONFIG_PSA_WANT_ALG_RSA_PKCS1V15_CRYPT=y
CONFIG_PSA_WANT_ALG_RSA_PKCS1V15_SIGN=y
CONFIG_PSA_WANT_KEY_TYPE_RSA_PUBLIC_KEY=y

# RSA requires that at least one key size is enabled
CONFIG_PSA_WANT_RSA_KEY_SIZE_1024=y

# Modem key management needs to be set to n, if not the certificate are provisioned to the modem
CONFIG_MODEM_KEY_MGMT=n
```

## src/main.c
```c
#include <zephyr/logging/log.h>
LOG_MODULE_REGISTER(wss_client, LOG_LEVEL_INF);

#include <zephyr/net/socket.h>
#include <zephyr/net/websocket.h>
#include <zephyr/net/tls_credentials.h>
#include <modem/nrf_modem_lib.h>
#include <modem/lte_lc.h>

#define SERVER_HOST "echo.websocket.events"
#define SERVER_PORT 443
#define SERVER_ADDR "35.71.131.46"  // IPv4
#define MSG_BUF_SIZE 1024

static uint8_t recv_buf[MSG_BUF_SIZE];

static int connect_tls_socket(const char *addr_str, int port)
{
	struct sockaddr_in addr = {
		.sin_family = AF_INET,
		.sin_port = htons(port),
	};
	inet_pton(AF_INET, addr_str, &addr.sin_addr);

	int sock = socket(AF_INET, SOCK_STREAM, IPPROTO_TLS_1_2);
	if (sock < 0) {
		LOG_ERR("Failed to create TLS socket: %d", errno);
		return -1;
	}

	int verify = TLS_PEER_VERIFY_NONE;
	setsockopt(sock, SOL_TLS, TLS_PEER_VERIFY, &verify, sizeof(verify));
	setsockopt(sock, SOL_TLS, TLS_HOSTNAME, SERVER_HOST, strlen(SERVER_HOST));

	if (connect(sock, (struct sockaddr *)&addr, sizeof(addr)) < 0) {
		LOG_ERR("TLS connect failed: %d", errno);
		close(sock);
		return -1;
	}

	return sock;
}

int main(void)
{
	nrf_modem_lib_init();

	if (lte_lc_connect() != 0) {
		LOG_ERR("LTE connection failed");
		return 1;
	}

	LOG_INF("Connecting...");

	int sock = connect_tls_socket(SERVER_ADDR, SERVER_PORT);
	if (sock < 0) {
		LOG_ERR("Failed to establish TLS socket.");
		return 1;
	}

	struct websocket_request req = {
		.host = SERVER_HOST,
		.url = "/",
		.tmp_buf = recv_buf,
		.tmp_buf_len = sizeof(recv_buf),
	};

	int ws_sock = websocket_connect(sock, &req, 3000, "IPv4");
	if (ws_sock < 0) {
		LOG_ERR("WebSocket connect failed: %d", ws_sock);
		close(sock);
		return 1;
	}

	LOG_INF("WebSocket connected.");

	char msg[32];
	uint64_t remaining;
	uint32_t type;
	int count = 1;
	int ret;

	// Receive and discard the initial unsolicited message
	ret = websocket_recv_msg(ws_sock, recv_buf, sizeof(recv_buf),
							&type, &remaining, 1000);

	if (ret > 0) {
		if (ret >= sizeof(recv_buf)) ret = sizeof(recv_buf) - 1;
		recv_buf[ret] = '\0';
		LOG_INF("Initial message: %s", recv_buf);
	} else if (ret == -EAGAIN) {
		LOG_WRN("No initial message received yet");
	} else {
		LOG_ERR("Error receiving initial message: %d", ret);
	}

	while (1) {

		snprintk(msg, sizeof(msg), "test%d", count++);
		websocket_send_msg(ws_sock, msg, strlen(msg),
		                   WEBSOCKET_OPCODE_DATA_TEXT, true, true, SYS_FOREVER_MS);
		LOG_INF("Sent: %s", msg);

		while (true) {
			ret = websocket_recv_msg(ws_sock, recv_buf, sizeof(recv_buf),
			                         &type, &remaining, SYS_FOREVER_MS);

			if (ret == -EAGAIN) {
				k_sleep(K_MSEC(100));
				continue;
			} else if (ret > 0) {
				recv_buf[ret] = '\0';
				LOG_INF("Received: %s", recv_buf);
				break;
			} else {
				LOG_ERR("Receive error: %d", ret);
				goto out;
			}
		}

		k_sleep(K_SECONDS(2));
	}

	out:

	close(ws_sock);
	close(sock);
	return 0;
}
```
